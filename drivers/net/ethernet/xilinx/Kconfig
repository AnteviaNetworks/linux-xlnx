## drivers/net/ethernet/xilinx/Kconfig
```kconfig
# SPDX-License-Identifier: GPL-2.0-only
#
# Xilinx device configuration
#

config NET_VENDOR_XILINX
	bool "Xilinx devices"
	default y
	help
	  If you have a network (Ethernet) card belonging to this class, say Y.

	  Note that the answer to this question doesn't directly affect the
	  kernel: saying N will just cause the configurator to skip all
	  the questions about Xilinx devices. If you say Y, you will be asked
	  for your specific card in the following questions.

if NET_VENDOR_XILINX

config XILINX_EMACLITE
	tristate "Xilinx 10/100 Ethernet Lite support"
	depends on HAS_IOMEM
	select PHYLIB
	help
	  This driver supports the 10/100 Ethernet Lite from Xilinx.

config XILINX_AXI_EMAC
	tristate "Xilinx 10/100/1000 AXI Ethernet support"
	depends on HAS_IOMEM
	select PHYLIB
	help
	  This driver supports the 10/100/1000 Ethernet from Xilinx for the
	  AXI bus interface used in Xilinx Virtex FPGAs and Soc's.

config XILINX_AXI_EMAC_HWTSTAMP
	bool "Generate hardware packet timestamps"
	depends on XILINX_AXI_EMAC
	select PTP_1588_CLOCK
	help
	  Generate hardware packet timestamps. This is to facilitate IEEE 1588.

config ANTEVIA_HWTSTAMP_SKB
	bool "Send and receive PTP timestamps in the packet data buffer"
	depends on XILINX_AXI_EMAC
	select XILINX_AXI_EMAC_HWTSTAMP
	default n
	help
	  RX timestamps are received in head of packets received on S2MM
	  DMA channels. The signal to collect TX timestamp on a packet is
	  sent in the head of packets sent on the MM2S channels. This
	  eliminates the RX TS FIFO and the transmit half of the TX TS FIFO.
	  RX packets and RX timestamps will never get out of sync.

config  AXIENET_HAS_MCDMA
	bool "AXI Ethernet is configured with MCDMA"
	depends on XILINX_AXI_EMAC
	help
	  When hardware is generated with AXI Ethernet with MCDMA select this option.

config  AXIENET_HAS_SHARED_MCDMA
	bool "AXI Ethernet is configured with shared MCDMA"
	depends on AXIENET_HAS_MCDMA
	default n
	help
	  When hardware is generated with multiple AXI Ethernet cores with a shared MCDMA select this option.

config XILINX_LL_TEMAC
	tristate "Xilinx LL TEMAC (LocalLink Tri-mode Ethernet MAC) driver"
	depends on HAS_IOMEM
	select PHYLIB
	help
	  This driver supports the Xilinx 10/100/1000 LocalLink TEMAC
	  core used in Xilinx Spartan and Virtex FPGAs

endif # NET_VENDOR_XILINX
```
